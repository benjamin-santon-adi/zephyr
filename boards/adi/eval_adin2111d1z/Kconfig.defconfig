## boards/adi/eval_adin2111d1z/Kconfig.defconfig
```kconfig
# ADI EVAL-ADIN2111D1Z board configuration

# Copyright (c) 2024 BayLibre
# SPDX-License-Identifier: Apache-2.0

if BOARD_ADI_EVAL_ADIN2111D1Z

configdefault ETH_DRIVER
	default y

if ETH_ADIN2111

configdefault ETH_ADIN2111_SWITCH_IFACE
	default y

endif # ETH_ADIN2111

endif # BOARD_ADI_EVAL_ADIN2111D1Z
```

## boards/adi/eval_adin2111ebz/Kconfig.defconfig
```kconfig
# ADI EVAL-ADIN2111EBZ board configuration

# Copyright (c) 2024 BayLibre
# SPDX-License-Identifier: Apache-2.0

if BOARD_ADI_EVAL_ADIN2111EBZ

configdefault SPI_STM32_DMA
	default y

configdefault ETH_DRIVER
	default y

if ETH_ADIN2111

configdefault NET_ETHERNET_BRIDGE
	default y

endif # ETH_ADIN2111

endif # BOARD_ADI_EVAL_ADIN2111EBZ
```

## drivers/ethernet/Kconfig.adin2111
```kconfig
# Copyright (c) 2023 PHOENIX CONTACT Electronics GmbH
# SPDX-License-Identifier: Apache-2.0

menuconfig ETH_ADIN2111
	bool "ADIN2111 2-port 10BASE-T1L Controller"
	default y
	depends on DT_HAS_ADI_ADIN2111_ENABLED || DT_HAS_ADI_ADIN1110_ENABLED
	select ETH_PHY_DRIVER
	select SPI
	imply CRC
	help
	  The ADIN2111 is a low power, 2-port 10BASE-T1L transceiver
	  designed for industrial Ethernet applications, and is compliant with
	  the IEEE® 802.3cg-2019™ Ethernet standard for long reach, 10
	  Mbps single pair Ethernet (SPE).

	  Featuring an integrated media access control (MAC) and a switch,
	  the ADIN2111 enables direct connectivity with a variety of controllers
	  via a serial peripheral inter-face (SPI).

if ETH_ADIN2111

config ETH_ADIN2111_IRQ_THREAD_STACK_SIZE
	int "Stack size for a thread that processes ADIN IRQ"
	default 2048
	help
	  Size of the stack used for internal thread which is ran to
	  process raised INT IRQ.

config ETH_ADIN2111_IRQ_THREAD_PRIO
	int "Priority for internal incoming packet handler"
	default 2
	help
	  Priority level for internal thread which is ran for ADIN
	  INT IRQ processing.

config ETH_ADIN2111_TIMEOUT
	int "IP buffer timeout"
	default 100
	help
	  Given timeout in milliseconds. Maximum amount of time
	  that the driver will wait from the IP stack to get
	  a memory buffer before the Ethernet frame is dropped.

config ETH_ADIN2111_SPI_CFG0
	bool "SPI_CFG0"
	default y
	help
	  Must be set when ADIN uses 8-bit CRC (Generic SPI)
	  or Protection Mode (OPEN Alliance) on the SPI Host Interface.

config ETH_ADIN2111_BUFFER_SIZE
	int "Buffer size in bytes use for frame transmission"
	default 1524
	help
	  Transmission and reception buffer size.

config ETH_ADIN2111_SWITCH_IFACE
	bool "Switch interface for the IP traffic of the ADIN2111"
	default y
	depends on DT_HAS_ADI_ADIN2111_ENABLED
	help
	  Support a third network interface on an ADIN2111, next to the two port
	  interfaces. The interface is created for each ADIN2111 devicetree node
	  that has a "switch" child with status "okay" and a local-mac-address.

	  The switch interface owns the MAC and IP addresses of the device, and
	  carries the IP traffic of both ports: a frame it sends leaves by the
	  port of its destination, and the frames received from both ports for
	  the host arrive on it.

	  The port interfaces keep the frames of the link-local protocols such as
	  LLDP, gPTP and STP, and cannot carry IP. The ADIN2111 forwards the
	  frames between its two ports in hardware, the host takes no part in it.

	  Disable it to leave the code out when no node uses it.

config ETH_ADIN2111_SWITCH_FDB_SIZE
	int "Number of stations the switch interface remembers"
	default 8
	range 1 64
	depends on ETH_ADIN2111_SWITCH_IFACE
	help
	  The ADIN2111 cannot choose the egress port of a frame the host sends.
	  The switch interface learns the port of a station from the frames it
	  receives from it, and sends to a station it does not know on both ports.

config ETH_ADIN2111_SWITCH_FDB_AGEING_TIME
	int "Seconds before the switch interface forgets a station"
	default 300
	range 1 86400
	depends on ETH_ADIN2111_SWITCH_IFACE

endif # ETH_ADIN2111
```

## dts/bindings/net/zephyr,ethernet-bridge.yaml
```yaml
# SPDX-License-Identifier: Apache-2.0

description: |
  Ethernet bridge of Ethernet network interfaces, created at start-up.

  The bridge is a network interface of its own, the IP configuration of the host
  goes on it. When the ports forward between them in hardware (they report
  ETHERNET_HW_PORT_FORWARDING), the bridge does not forward anything in
  software: it learns on which port each station is, delivers the frames for
  the host and sends the frames of the host out of the port of their
  destination.

  Example:

    / {
            bridge0: bridge {
                    compatible = "zephyr,ethernet-bridge";
                    ports = <&port1 &port2>;
                    local-mac-address = [00 aa 22 fe da c8];
            };
    };

compatible: "zephyr,ethernet-bridge"

include: base.yaml

properties:
  ports:
    type: phandles
    required: true
    description: |
      The network devices whose network interface is a port of the bridge, at
      least two. A device needs one network interface.

  local-mac-address:
    type: uint8-array
    description: |
      MAC address of the bridge interface. It is the address of the first port
      when it is not set. The ports keep their own addresses. A port that
      filters the received frames by address (ETHERNET_HW_FILTERING), like the
      ADIN2111, is told to also let through the frames for this address.
```
